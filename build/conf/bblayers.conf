## build/conf/bblayers.conf
```bitbake
# POKY_BBLAYERS_CONF_VERSION is increased each time build/conf/bblayers.conf
# changes incompatibly
POKY_BBLAYERS_CONF_VERSION = "2"

BBPATH = "${TOPDIR}"
BBFILES ?= ""

BBLAYERS ?= " \
  /home/aov634/yocto/poky/meta \
  /home/aov634/yocto/poky/meta-poky \
  /home/aov634/yocto/poky/meta-yocto-bsp \
  "
```
